## conf/layer.conf
```bitbake
# We have a conf and classes directory, add to BBPATH
BBPATH .= ":${LAYERDIR}"

# We have recipes-* directories, add to BBFILES
BBFILES += "${LAYERDIR}/recipes-*/*/*.bb ${LAYERDIR}/recipes-*/*/*.bbappend"

BBFILE_COLLECTIONS += "balena-engine"
BBFILE_PATTERN_balena-engine = "^${LAYERDIR}/"
BBFILE_PRIORITY_balena-engine = "1"

# This should only be incremented on significant changes that will
# cause compatibility issues with other layers
LAYERVERSION_balena-engine = "1"

LAYERDEPENDS_balena-engine = " \
    core \
    openembedded-layer \
    virtualization-layer \
    "

LAYERSERIES_COMPAT_balena-engine = "dunfell master"
```
